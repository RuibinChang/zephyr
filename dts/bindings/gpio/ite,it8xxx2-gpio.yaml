## dts/bindings/gpio/ite,it8xxx2-gpio.yaml
```yaml
# Copyright (c) 2020 ITE Corporation. All Rights Reserved.
# SPDX-License-Identifier: Apache-2.0

description: This binding gives a base representation of the ITE gpio

compatible: "ite,it8xxx2-gpio"

include: [gpio-controller.yaml, base.yaml]

properties:
    reg:
      required: true

    wucctrl:
      type: phandles
      description: |
        Configure wakeup controller, this controller is used to set that
        when the interrupt is triggered in EC low power mode, it can wakeup
        EC or not. Via this controller, we set the wakeup trigger edge,
        enable, disable, and clear wakeup status for the specific pin which
        may be gpio pins or alternate pins.

    label:
      required: true

gpio-cells:
  - pin
  - flags
```
