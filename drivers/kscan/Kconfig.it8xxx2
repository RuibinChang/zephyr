## drivers/kscan/Kconfig.it8xxx2
```kconfig
# Copyright (c) 2021 ITE Corporation. All Rights Reserved.
# SPDX-License-Identifier: Apache-2.0

menuconfig KSCAN_IT8XXX2
	bool "ITE KSCAN driver"
	depends on (SOC_IT8XXX2)
	select MULTITHREADING
	help
	  This option enables the ITE Kscan IO driver.

if KSCAN_IT8XXX2

config KSCAN_IT8XXX2_COLUMN_SIZE
	int "KSCAN_IT8XXX2_COLUMN_SIZE"
	default 16				#chrome:KEYBOARD_COLS_MAX without keypad is 13 (default = 14)
	help
	  Adjust the value to your keyboard columns. The maximum
	  column size for the ITE family is 18 (from 0 to 17).

config KSCAN_IT8XXX2_ROW_SIZE
	int "KSCAN_IT8XXX2_ROW_SIZE"
	default 8
	help
	  Adjust the value to your keyboard rows. The maximum
	  column size for the ITE family is 8 (from 0 to 7).

config KSCAN_IT8XXX2_DEBOUNCE_DOWN
	int "KSCAN_IT8XXX2_DEBOUNCE_DOWN"
	default 9				#chrome:keyscan_config (common)
	help
	  Determines the time in msecs for debouncing a key press.

config KSCAN_IT8XXX2_DEBOUNCE_UP
	int "KSCAN_IT8XXX2_DEBOUNCE_UP"
	default 30				#chrome:keyscan_config (common)
	help
	  Determines the time in msecs for debouncing a key release.

config KSCAN_IT8XXX2_POLL_PERIOD
	int "KSCAN_IT8XXX2_POLL_PERIOD"
	default 3				#chrome:keyscan_config (common)
	help
	  Defines the poll period in msecs between matrix scans.

endif # KSCAN_IT8XXX2
```

## dts/bindings/kscan/ite,it8xxx2-kscan.yaml
```yaml
# Copyright (c) 2021 ITE Corporation. All Rights Reserved.
# SPDX-License-Identifier: Apache-2.0

description: ITE it8xxx2 keyboard matrix controller

compatible: "ite,it8xxx2-kscan"

include: kscan.yaml                      #not sure

properties:                              #not sure
    "#address-cells":
      required: true
      const: 1
    "#size-cells":
      type: int
      const: 0
    reg:
      required: true

    interrupts:
      required: true
```
